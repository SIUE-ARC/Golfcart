;;*****************************************************************************
;;*****************************************************************************
;;  FILENAME:   Steer_Pot.inc  ( PGA )
;;  Version: 3.2, Updated on 2015/3/4 at 22:26:46
;;  Generated by PSoC Designer 5.4.3191
;;
;;  DESCRIPTION:  Assembler declarations for the PGA user module interface.
;;-----------------------------------------------------------------------------
;;  Copyright (c) Cypress Semiconductor 2015. All Rights Reserved.
;;*****************************************************************************
;;*****************************************************************************

;--------------------------------------------------
; Constants for Steer_Pot API's.
;--------------------------------------------------

Steer_Pot_OFF:         equ 0
Steer_Pot_LOWPOWER:    equ 1
Steer_Pot_MEDPOWER:    equ 2
Steer_Pot_HIGHPOWER:   equ 3

Steer_Pot_G48_0:       equ 0Ch
Steer_Pot_G24_0:       equ 1Ch
Steer_Pot_G16_0:       equ 08h
Steer_Pot_G8_00:       equ 18h
Steer_Pot_G5_33:       equ 28h
Steer_Pot_G4_00:       equ 38h
Steer_Pot_G3_20:       equ 48h
Steer_Pot_G2_67:       equ 58h
Steer_Pot_G2_27:       equ 68h
Steer_Pot_G2_00:       equ 78h
Steer_Pot_G1_78:       equ 88h
Steer_Pot_G1_60:       equ 98h
Steer_Pot_G1_46:       equ A8h
Steer_Pot_G1_33:       equ B8h
Steer_Pot_G1_23:       equ C8h
Steer_Pot_G1_14:       equ D8h
Steer_Pot_G1_06:       equ E8h
Steer_Pot_G1_00:       equ F8h
Steer_Pot_G0_93:       equ E0h
Steer_Pot_G0_87:       equ D0h
Steer_Pot_G0_81:       equ C0h
Steer_Pot_G0_75:       equ B0h
Steer_Pot_G0_68:       equ A0h
Steer_Pot_G0_62:       equ 90h
Steer_Pot_G0_56:       equ 80h
Steer_Pot_G0_50:       equ 70h
Steer_Pot_G0_43:       equ 60h
Steer_Pot_G0_37:       equ 50h
Steer_Pot_G0_31:       equ 40h
Steer_Pot_G0_25:       equ 30h
Steer_Pot_G0_18:       equ 20h
Steer_Pot_G0_12:       equ 10h
Steer_Pot_G0_06:       equ 00h

Steer_Pot_AGNDBUFAPI:  equ 0

;--------------------------------------------------
; Register Address Constants used by Steer_Pot
;--------------------------------------------------
Steer_Pot_GAIN_CR0: equ 71h
Steer_Pot_GAIN_CR1: equ 72h
Steer_Pot_GAIN_CR2: equ 73h
Steer_Pot_GAIN_CR3: equ 70h

