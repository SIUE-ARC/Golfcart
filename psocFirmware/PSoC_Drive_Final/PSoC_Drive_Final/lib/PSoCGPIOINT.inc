;  Generated by PSoC Designer 5.4.3191
;
;
;  PSoCGPIOINT.inc
;
;  Data: 29 October, 2001
;  Copyright (c) Cypress Semiconductor 2015. All Rights Reserved.
;
;  This file is generated by the Device Editor on Application Generation.
;  It contains equates that are useful in writing code relating to GPIO
;  related interrupts.
;  
;  DO NOT EDIT THIS FILE MANUALLY, AS IT IS OVERWRITTEN!!!
;  Edits to this file will not be preserved.
;
; OpEncB address and mask equates
OpEncB_Data_ADDR:	equ	4h
OpEncB_DriveMode_0_ADDR:	equ	104h
OpEncB_DriveMode_1_ADDR:	equ	105h
OpEncB_DriveMode_2_ADDR:	equ	7h
OpEncB_GlobalSelect_ADDR:	equ	6h
OpEncB_IntCtrl_0_ADDR:	equ	106h
OpEncB_IntCtrl_1_ADDR:	equ	107h
OpEncB_IntEn_ADDR:	equ	5h
OpEncB_MASK:	equ	20h
; OpEncA address and mask equates
OpEncA_Data_ADDR:	equ	4h
OpEncA_DriveMode_0_ADDR:	equ	104h
OpEncA_DriveMode_1_ADDR:	equ	105h
OpEncA_DriveMode_2_ADDR:	equ	7h
OpEncA_GlobalSelect_ADDR:	equ	6h
OpEncA_IntCtrl_0_ADDR:	equ	106h
OpEncA_IntCtrl_1_ADDR:	equ	107h
OpEncA_IntEn_ADDR:	equ	5h
OpEncA_MASK:	equ	10h
; AnalogOutBuf_0 address and mask equates
AnalogOutBuf_0_Data_ADDR:	equ	0h
AnalogOutBuf_0_DriveMode_0_ADDR:	equ	100h
AnalogOutBuf_0_DriveMode_1_ADDR:	equ	101h
AnalogOutBuf_0_DriveMode_2_ADDR:	equ	3h
AnalogOutBuf_0_GlobalSelect_ADDR:	equ	2h
AnalogOutBuf_0_IntCtrl_0_ADDR:	equ	102h
AnalogOutBuf_0_IntCtrl_1_ADDR:	equ	103h
AnalogOutBuf_0_IntEn_ADDR:	equ	1h
AnalogOutBuf_0_MASK:	equ	8h
; F_or_R address and mask equates
F_or_R_Data_ADDR:	equ	4h
F_or_R_DriveMode_0_ADDR:	equ	104h
F_or_R_DriveMode_1_ADDR:	equ	105h
F_or_R_DriveMode_2_ADDR:	equ	7h
F_or_R_GlobalSelect_ADDR:	equ	6h
F_or_R_IntCtrl_0_ADDR:	equ	106h
F_or_R_IntCtrl_1_ADDR:	equ	107h
F_or_R_IntEn_ADDR:	equ	5h
F_or_R_MASK:	equ	4h
; Autonomous_Toggle address and mask equates
Autonomous_Toggle_Data_ADDR:	equ	4h
Autonomous_Toggle_DriveMode_0_ADDR:	equ	104h
Autonomous_Toggle_DriveMode_1_ADDR:	equ	105h
Autonomous_Toggle_DriveMode_2_ADDR:	equ	7h
Autonomous_Toggle_GlobalSelect_ADDR:	equ	6h
Autonomous_Toggle_IntCtrl_0_ADDR:	equ	106h
Autonomous_Toggle_IntCtrl_1_ADDR:	equ	107h
Autonomous_Toggle_IntEn_ADDR:	equ	5h
Autonomous_Toggle_MASK:	equ	8h
