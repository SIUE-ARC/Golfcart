;;*****************************************************************************
;;*****************************************************************************
;;  FILENAME:   Actuator_Pot.inc  ( PGA )
;;  Version: 3.2, Updated on 2015/3/4 at 22:26:46
;;  Generated by PSoC Designer 5.4.3191
;;
;;  DESCRIPTION:  Assembler declarations for the PGA user module interface.
;;-----------------------------------------------------------------------------
;;  Copyright (c) Cypress Semiconductor 2015. All Rights Reserved.
;;*****************************************************************************
;;*****************************************************************************

;--------------------------------------------------
; Constants for Actuator_Pot API's.
;--------------------------------------------------

Actuator_Pot_OFF:         equ 0
Actuator_Pot_LOWPOWER:    equ 1
Actuator_Pot_MEDPOWER:    equ 2
Actuator_Pot_HIGHPOWER:   equ 3

Actuator_Pot_G48_0:       equ 0Ch
Actuator_Pot_G24_0:       equ 1Ch
Actuator_Pot_G16_0:       equ 08h
Actuator_Pot_G8_00:       equ 18h
Actuator_Pot_G5_33:       equ 28h
Actuator_Pot_G4_00:       equ 38h
Actuator_Pot_G3_20:       equ 48h
Actuator_Pot_G2_67:       equ 58h
Actuator_Pot_G2_27:       equ 68h
Actuator_Pot_G2_00:       equ 78h
Actuator_Pot_G1_78:       equ 88h
Actuator_Pot_G1_60:       equ 98h
Actuator_Pot_G1_46:       equ A8h
Actuator_Pot_G1_33:       equ B8h
Actuator_Pot_G1_23:       equ C8h
Actuator_Pot_G1_14:       equ D8h
Actuator_Pot_G1_06:       equ E8h
Actuator_Pot_G1_00:       equ F8h
Actuator_Pot_G0_93:       equ E0h
Actuator_Pot_G0_87:       equ D0h
Actuator_Pot_G0_81:       equ C0h
Actuator_Pot_G0_75:       equ B0h
Actuator_Pot_G0_68:       equ A0h
Actuator_Pot_G0_62:       equ 90h
Actuator_Pot_G0_56:       equ 80h
Actuator_Pot_G0_50:       equ 70h
Actuator_Pot_G0_43:       equ 60h
Actuator_Pot_G0_37:       equ 50h
Actuator_Pot_G0_31:       equ 40h
Actuator_Pot_G0_25:       equ 30h
Actuator_Pot_G0_18:       equ 20h
Actuator_Pot_G0_12:       equ 10h
Actuator_Pot_G0_06:       equ 00h

Actuator_Pot_AGNDBUFAPI:  equ 0

;--------------------------------------------------
; Register Address Constants used by Actuator_Pot
;--------------------------------------------------
Actuator_Pot_GAIN_CR0:  equ 75h
Actuator_Pot_GAIN_CR1:  equ 76h
Actuator_Pot_GAIN_CR2:  equ 77h
Actuator_Pot_GAIN_CR3:  equ 74h

